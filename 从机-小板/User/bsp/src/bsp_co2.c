/*
*********************************************************************************************************
*
*	模块名称 : xxx驱动模块
*	文件名称 : bsp_xxx.c
*	版    本 : V1.0
*	说    明 : 驱动xxx，配合新建工程使用，非完整文件
*

*********************************************************************************************************
*/

#include "bsp.h"

static const uint8_t CO2_READ_CMD[9] = {0XFF,0X01,0X86,0X00,0X00,0X00,0X00,0X00,0X79};//读取CO2命令
uint8_t CO2_TEMP_BUF[CO2_TEMP_BUF_LEN] = {0X00};//CO2缓存
/*
*********************************************************************************************************
*	函 数 名: CO2_TEMP_BUF_Clear
*	功能说明: CO2缓存清除
*	形    参:  无
*	返 回 值: 无
*********************************************************************************************************
*/
void CO2_TEMP_BUF_Clear(void)
{
	uint8_t i = 0;
	for(i = 0; i < CO2_TEMP_BUF_LEN;i++)
	{
		CO2_TEMP_BUF[i] = 0;
		
	}
}

/*
*********************************************************************************************************
*	函 数 名: getCheckSum
*	功能说明: 计算和校验
*	形    参:  uint8_t *packet 数据指针
*	返 回 值: 返回和校验值
*********************************************************************************************************
*/
uint8_t getCheckSum(uint8_t *packet)
{
	uint8_t i,checksum = 0;
	for(i = 1;i < 8; i ++)
	{
		checksum += packet[i];
	}
	checksum = 0xff - checksum;
	checksum += 1;
	return checksum;
	
}

/*
*********************************************************************************************************
*	函 数 名: CO2_READ
*	功能说明: CO2读取数据
*	形    参:  
*	返 回 值: 返回CO2的值
*********************************************************************************************************
*/
uint16_t CO2_READ(void)
{
	uint16_t co2_value = 0;
	uint8_t len3 = 0;
	
	USART2_Send_Data((uint8_t*)CO2_READ_CMD,9);//读取CO2的值
	delay_ms(20);
	USART2_Receive_Data(CO2_TEMP_BUF,&len3);
	
	if((len3 == 9)&&(getCheckSum(CO2_TEMP_BUF) == CO2_TEMP_BUF[8]))
	{
		co2_value = CO2_TEMP_BUF[2];
		co2_value = (co2_value << 8)+ CO2_TEMP_BUF[3];
		
		len3 = 0;
		CO2_TEMP_BUF_Clear();//清空buf
		return co2_value;//返回正确数值
	}
	else
	{
		
		co2_value = 65535;//返回错误数值
		CO2_TEMP_BUF_Clear();//清空buf
		return co2_value;//返回错误数值
	}
}
/**********************************************************************************************************/





