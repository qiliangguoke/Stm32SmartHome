/*
*********************************************************************************************************
*
*	模块名称 : PM2.5传感器模块
*	文件名称 : bsp_pm2.5.c
*	版    本 : V1.0
*	说    明 : 
*
*	修改记录 :
*		版本号  日期        作者     说明
*		V1.0    2023-06-12 季振宗  正式发布
*
*	Copyright (C), 2014-2019, 德致伦电子
*
*********************************************************************************************************
*/

///////////////////////////////////////
/* 头文件包含区 */
#include "bsp.h"
///////////////////////////////////////
/* 变量定义区 */
static const uint8_t PM25_READ_CMD[9]={0xFF,0x01,0x86,0x00,0x00,0x00,0x00,0x00,0x79};//读取 PM25 命令
uint8_t PM25_TEMP_BUF[PM25_TEMP_BUF_LEN]={0x00};//PM25 缓存
///////////////////////////////////////
/* 函数实体区 */
/*
*********************************************************************************************************
*	函 数 名: 
*	功能说明: 
*	形    参：无
*	返 回 值: 无
*********************************************************************************************************
*/
void PM25_TEMP_BUF_Clear(void)
{
	uint8_t i=0;
	for(i=0;i<PM25_TEMP_BUF_LEN;i++)
	{
		PM25_TEMP_BUF[i]=0;
	}
}
/*
*********************************************************************************************************
*	函 数 名: 
*	功能说明: 
*	形    参：无
*	返 回 值: 无
*********************************************************************************************************
*/
uint8_t getchecksum1(uint8_t *packet)
{
	uint8_t i,checksum1=0;
	for(i=1;i<8;i++)
	{
		checksum1 += packet[i];
	}
	checksum1 = 0xff - checksum1;
	checksum1 += 1;
	return checksum1;
}
/*
*********************************************************************************************************
*	函 数 名: 
*	功能说明: 
*	形    参：无
*	返 回 值: 无
*********************************************************************************************************
*/
uint16_t PM25_READ(void)
{
	uint16_t PM25_value = 0;
	uint8_t len4 = 0;
	
	UART5_Send_Data( (uint8_t*)PM25_READ_CMD,9);//读取 PM25 数值
	delay_ms(20);
	UART5_Receive_Data(PM25_TEMP_BUF,&len4);
	
	if( ( len4 == 9 ) && ( getchecksum1( PM25_TEMP_BUF ) == PM25_TEMP_BUF[8] ) )
	{
		PM25_value = PM25_TEMP_BUF[2];
		PM25_value = ( PM25_value << 8 ) + PM25_TEMP_BUF[3];
		//printf("PM25 value is %d \r\n",PM25_value);
		len4 = 0;
		PM25_TEMP_BUF_Clear();//清空 buf
		return PM25_value;//返回正确数值
	}
	else
	{
		//printf("len4=%d\r\n",len4);
		PM25_value = 65535;//返回错误数值
		PM25_TEMP_BUF_Clear();//清空 buf
		return PM25_value;//返返回错误数值
	}
}
/***************************** 德致伦电子 DeZLinc (END OF FILE) *********************************/
