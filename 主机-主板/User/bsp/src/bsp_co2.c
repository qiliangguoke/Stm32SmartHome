/*
*********************************************************************************************************
*
* 模块名称 : CO2 驱动模块
* 文件名称 : bsp_co2.c
* 版 本 : V1.0
* 说 明 : 驱动 CO2
*
* Copyright (C), 2014-2019, 德致伦电子
*
*********************************************************************************************************
*/
#include "bsp.h" 
static const uint8_t CO2_READ_CMD[9]={0xFF,0x01,0x86,0x00,0x00,0x00,0x00,0x00,0x79};//读取 CO2 命令
uint8_t CO2_TEMP_BUF[CO2_TEMP_BUF_LEN]={0x00};//CO2 缓存
/*
*********************************************************************************************************
* 函 数 名: CO2_TEMP_BUF_Clear
* 功能说明: CO2 缓存清除。
* 形 参：无
* 返 回 值: 无
*********************************************************************************************************
*/
void CO2_TEMP_BUF_Clear(void)
{
	uint8_t i=0;
	for(i=0;i<CO2_TEMP_BUF_LEN;i++)
	{
		CO2_TEMP_BUF[i]=0;
	}
}
/*
*********************************************************************************************************
* 函 数 名: getCheckSum
* 功能说明: 计算和校验。
* 形 参：uint8_t *packet 数据指针
* 返 回 值: 返回和校验值
*********************************************************************************************************
*/
uint8_t getCheckSum(uint8_t *packet)
{
	uint8_t i,checksum=0;
	for(i=1;i<8;i++)
	{
		checksum += packet[i];
	}
	checksum = 0xff - checksum;
	checksum += 1;
	return checksum;
}
/*
*********************************************************************************************************
* 函 数 名: CO2_READ
* 功能说明: CO2 读取数据。
* 形 参：无
* 返 回 值: 返回 CO2 值
*********************************************************************************************************
*/
uint16_t CO2_READ(void)
{
	uint16_t co2_value = 0;
	uint8_t len3 = 0;
	UART4_Send_Data( (uint8_t*)CO2_READ_CMD,9);//读取 CO2 数值
	delay_ms(20);
	UART4_Receive_Data(CO2_TEMP_BUF,&len3);
	if( ( len3 == 9 ) && ( getCheckSum( CO2_TEMP_BUF ) == CO2_TEMP_BUF[8] ) )
	{
		co2_value = CO2_TEMP_BUF[2];
		co2_value = ( co2_value << 8 ) + CO2_TEMP_BUF[3];
		//printf("CO2 value is %d \r\n",co2_value);
		len3 = 0;
		CO2_TEMP_BUF_Clear();//清空 buf
		return co2_value;//返回正确数值
	}
	else
	{
		//printf("len3 = %d\r\n",len3);
		co2_value = 65535;//返回错误数值
		CO2_TEMP_BUF_Clear();//清空 buf
		return co2_value;//返返回错误数值
	}
}
/***************************** 德致伦电子 DeZLinc (END OF FILE) *********************************/
